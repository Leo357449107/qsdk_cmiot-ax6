## qca/src/linux-4.4/Documentation/devicetree/bindings/arm/msm/qcom,diag.txt
```
Qualcomm Technologies, Inc. Diag Driver

This binding describes diag driver used for logging and debugging purposes
across all subsystems. It collects logging data from all subsystems and
forwards that data to the requesting client.

Required properties:
-compatible : should be "qcom,diag".

Example:
qcom,diag {
	compatible = "qcom,diag";
};
```

## qca/src/linux-4.4/Documentation/devicetree/bindings/remoteproc/q6v5-m3-rproc.txt
```
QCA Wakeup M3 Remoteproc Driver
=====================================

The IPQ807x family of devices uses a M3 co-processor. The M3
requires a firmware binary to boot. The q6-wcss remoteproc driver handles
the loading of firmware of M3. Q6V5-WCSS is dependent on this M3.

M3 Device Node:
================
A M3 device node is used to represent the M3 processor
instance within the SoC. It is needed as child node to SOC parent node
through which it is accessible to the IPQ807x.

Required properties:
--------------------
- compatible:		Should be one of,
				"qca,q6v5-m3-rproc" for IPQ807x SoCs
- firmware:		Name of firmware file to be used for loading and
			booting the q6-wcss remote processor.
- qca,auto-restart      states that q6 is restarted after receiving error fatal
			from q6
- qca,secure		notifies that TZ is used for bringing q6 out of reset

Example:
--------
/* IPQ807x */
q6v5_m3: q6v5_m3 {
	compatible = "qca,q6v5-m3-rproc";
	firmware = "IPQ8074/m3_fw.mdt";
	qca,auto-restart;
	qcom,restart-group = <&q6v5_m3 &q6v5_wcss>;
};
```

## qca/src/linux-4.4/Documentation/devicetree/bindings/soc/qcom/qca,scm_restart_reason.txt
```
QCA SCM_RESTART_REASON

scm restart reason driver controls the collection of crashdump.
During panic/assert the notifiers registered in this driver will be kicked in
and the magic cookie is set, the crashdumps are collected in apps bootloader.

Required properties:
 - compatible: must contain "qca,scm_restart_reason" for IPQ40xx

Optional properties:
 - dload_status: indicate whether memory is reserved for crashdump.
 - dload_sec_status: indicate whether crashdump is enabled for
   secure boot.

Example for ipq40xx:

	qca,scm_restart_reason {
		compatible = "qca,scm_restart_reason";
		dload_status = <0>;
		dload_sec_status = <0>;
	};
```

## qca/src/linux-4.4/Documentation/devicetree/bindings/soc/qcom/qca,tzlog.txt
```
QCA TZLOG

This binding describes tzlog used to inspect log created by TZ. This driver
also provides capability to capture SMMU and XPU faults found by TZ.

Required properties:
 - compatible: must contain one of "qca,tzlog"
				   "qca,tz64-hv-log"
				   "qca,tz64log"
					"qca,tzlog_ipq6018"
 - interrupts: must contain interrupt used by TZ when XPU or SMMU faults are
		found

Optional properties:
 - qca,tzbsp-diag-buf-size: contains the TZ diag buffer size. If not defined,
				memory of 4K will be used.
 - qca,hyp-enabled: defines whether TZ supports Hypervisor mode or not.
 - hyp-scm-cmd-id: contains the SCM command id to get the hypervisor diag log.
			If not defined, default value 0x7 will be used.

Example:

	qca,tzlog {
		compatible = "qca,tz64log";
		interrupts = <0 244 0>;
	};

	qca,tzlog {
		compatible = "qca,tz64-hv-log";
		interrupts = <0 244 0>;
	};

	qca,tzlog {
		compatible = "qca,tzlog";
	};

	tzlog: qca,tzlog {
		compatible = "qca,tzlog_ipq6018";
		interrupts = <GIC_SPI 244 IRQ_TYPE_EDGE_RISING>;
		qca,tzbsp-diag-buf-size = <0x3000>;
		qca,hyp-enabled;
		hyp-scm-cmd-id = <0xA>;
	};
```

## qca/src/linux-4.4/Documentation/devicetree/bindings/soc/qcom/qcom,bt.txt
```
QTI Inter-processor communication driver binding

This binding describes the QTI Blutooth Inter-processor communication
driver, used to download firmware/patch and means to communicate and transfer
data between Bluetooth device and host subsystems.

- compatible:
	Usage: required
	Value type: <stringlist>
	Definition: must be:
		    "qcom,bt"

-firmware:
	Usage: required
	Value type: <string>
	Definition: firmware/pathc location in filesystem.

- memory-region:
	Usage: required
	Value type: <prop-encoded-array>
	Definition: handle to memory reservation for main shared memory region.

- qcom,ipc:
	Usage: required
	Value type: <prop-encoded-array>
	Definition: three entries specifying the outgoing ipc bit used for
		    signaling the remote processor
		    - phandle to a syscon node representing the apcs registers
		    - u32 representing offset to the register within the syscon
		    - u32 representing the ipc bit within the register

- interrupts:
	Usage: required
	Value type: <prop-encoded-array>
	Definition: one entry specifying the bt ipc interrupt

= EXAMPLE
The following example shows the BT Inter-processor communication driver setup
for IPQ5018.

	bt: bt@7000000 {
		compatible = "qcom,bt";
		firmware = "IPQ5018/bt.mdt";

		memory-region = <&bt_region>;

		qcom,ipc = <&apcs 8 23>;
		interrupts = <GIC_SPI 162 IRQ_TYPE_EDGE_RISING>;

		resets = <&gcc GCC_BTSS_BCR>;
		reset-names = "btss_reset";
	};
```

## qca/src/linux-4.4/Documentation/devicetree/bindings/sound/qca,ipq8074-audio-adss.txt
```
* Qualcomm Technologies, Inc IPQ8074 ASoC audio subsystem driver

This node models the Qualcomm Technologies, Inc IPQ8074 ASoC audio subsystem driver

Required properties:

- compatible	: "qca,ipq8074-audio-adss"
- reg		: should have the stereo register address, length
- resets	: references to the reset controllers
- reset-names	: should be "blk_rst"

Additionally, for slave mode we require a boolean called "slave;" in the node.

Example:

master:
audio: audio@7700000 {
	compatible = "qca,ipq8074-audio-adss";
	reg = <0x7700000 0x34>;
	resets = <&gcc AUDIO_BLK_ARES>;
	reset-names = "blk_rst";
	status = "disabled";
};

slave:
audio: audio@7700000 {
	compatible = "qca,ipq8074-audio-adss";
	reg = <0x7700000 0x34>;
	resets = <&gcc AUDIO_BLK_ARES>;
	reset-names = "blk_rst";
	status = "disabled";
	slave;
}

If the user wants to use pcm alone and not full fledged audio, and is going to
disable all other audio nodes, then "adss_init" must be added in pcm node as
shown below. Without adding this boolean, pcm will not work because adss_init
will not be done.

Example:

pcm: pcm@7704000 {
	compatible = "qca,ipq8074-pcm";
	reg = <0x7704000 0x2000>;
	adss_init;
	dma-tx-channel = <MBOX3_TX_ID>;
	dma-rx-channel = <MBOX0_RX_ID>;
	stereo-tx-port = <STEREO3_ID>;
	stereo-rx-port = <STEREO0_ID>;
	clocks = <&adss_clk ADSS_AUDIO_PCM_CLK>;
	clock-names = "audio_pcm_clk";
};

Note: When full fledged audio is enabled, ipq_audio_adss_init is done in the
sound card driver probe (ipq_audio_probe).
```

## qca/src/linux-4.4/arch/arm/mach-qcom/Kconfig
```kconfig
menuconfig ARCH_QCOM
	bool "Qualcomm Support" if ARCH_MULTI_V7
	select ARCH_SUPPORTS_BIG_ENDIAN
	select ARM_GIC
	select ARM_AMBA
	select PINCTRL
	select ARCH_WANT_KMAP_ATOMIC_FLUSH
	select QCOM_SCM if SMP
	select PCI_DOMAINS if PCI
	select ARM_GIC_V2M if PCI_MSI
	help
	  Support for Qualcomm's devicetree based systems.

if ARCH_QCOM

config ARCH_MSM8X60
	bool "Enable support for MSM8X60"
	select CLKSRC_QCOM

config ARCH_MSM8960
	bool "Enable support for MSM8960"
	select CLKSRC_QCOM

config ARCH_MSM8974
	bool "Enable support for MSM8974"
	select HAVE_ARM_ARCH_TIMER

config ARCH_IPQ256M
	bool "Enable 256M config"
	default n
	help
	  This sets the text offset of 256M profile, which makes kernel aware of
          first 16MB of DDR.

config SKB_FIXED_SIZE_2K
	bool "SKB size fixed at 2K"
	default n
	help
		This is a hint to the NSS driver that the ‘skbuff’ size might
		need to be fixed at 2KB, to conserve memory.

config ARCH_IPQ40XX
	bool "Enable Support for IPQ40XX"
	help
	  This enables support for the IPQ40XX chipset. This config can
	  be used to enable/disable modules based on target type.
	  If you dont know what do here, say N

config ARCH_IPQ806x
	bool "Enable Support for IPQ806x"
	help
	  This enables support for the IPQ806x chipset. This config can
	  be used to enable/disable modules based on target type.
	  If you dont know what do here, say N

config ARCH_IPQ807x
	bool "Enable Support for IPQ807x"
	select PINCTRL_IPQ807x
	select COMMON_CLK_QCOM
	select IPQ_APSS_807x
	select IPQ_GCC_807x
	help
	  This enables support for the IPQ807x chipset. If you dont
	  know what do here, say N

config ARCH_IPQ6018
	bool "Enable Support for IPQ6018"
	select PINCTRL_IPQ6018
	select COMMON_CLK_QCOM
	select IPQ_APSS_6018
	select IPQ_GCC_6018
	select SOC_BUS
	help
	  This enables support for the IPQ6018 chipset. If you dont
	  know what do here, say N

config ARCH_IPQ5018
	bool "Enable Support for IPQ5018"
	select PINCTRL_IPQ5018
	select COMMON_CLK_QCOM
	select IPQ_APSS_5018
	select IPQ_GCC_5018
	help
	  This enables support for the IPQ5018 chipset. If you dont
	  know what do here, say N

config IPQ_MEM_PROFILE
	int "Select Memory Profile"
	range 0 1024
	default 0
	---help---
	This option select memory profile to be used,which defines
	the reserved memory configuration used in device tree.

	If unsure, say 0

config IPQ_FLASH_16M_PROFILE
	bool "Enable 16M Flash Profile"
	default n
	---help---
	This option select flash profile to be used.

	If unsure, say n

config IPQ_FLASH_16M_PROFILE_DEBUG
	bool "Enable 16M Flash Profile"
	depends on IPQ_FLASH_16M_PROFILE
	default n
	---help---
	This option selects 16M flash debug profile.

	If unsure, say n

endif
```

## qca/src/linux-4.4/drivers/char/diag/Kconfig
```kconfig
menu "Diag Support"

config DIAG_CHAR
	tristate "char driver interface and diag forwarding to/from modem"
	default m
	depends on ARCH_QCOM
	select CRC_CCITT
	help
	 Char driver interface for diag user space and diag-forwarding to modem ARM and back.
	 This enables diagchar for maemo usb gadget or android usb gadget based on config selected.
endmenu

menu "DIAG traffic over USB"

config DIAG_OVER_USB
	bool "Enable DIAG traffic to go over USB"
        depends on ARCH_QCOM
	default y
	help
	 This feature helps segregate code required for DIAG traffic to go over USB.
endmenu

menu "DIAG traffic over QRTR"

config DIAG_OVER_QRTR
	bool "Enable DIAG traffic to go over QRTR"
        depends on QRTR
	default n
	help
	 This feature helps segregate code required for DIAG traffic to go over QRTR.
endmenu

menu "HSIC/SMUX support for DIAG"

config DIAGFWD_BRIDGE_CODE
	bool "Enable QSC/9K DIAG traffic over SMUX/HSIC"
	depends on DIAG_CHAR
	depends on USB_QCOM_DIAG_BRIDGE || MHI_BUS
	default y
	help
	 SMUX/HSIC Transport Layer for DIAG Router
endmenu
```

## qca/src/linux-4.4/drivers/slimbus/Kconfig
```kconfig
#
# SLIMBUS driver configuration
#
menuconfig SLIMBUS
	bool "Slimbus support"
	depends on HAS_IOMEM
	help
	  Slimbus is standard interface between baseband and
	  application processors and peripheral components in mobile
	  terminals.

if SLIMBUS
config SLIMBUS_MSM_CTRL
	tristate "QTI Slimbus Master Component"
	default n
	help
	  Select driver for QTI's Slimbus Master Component.

config SLIMBUS_MSM_NGD
	tristate "QTI Slimbus Satellite Component"
	help
	  Select driver for QTI's Slimbus Satellite Component.
	  This is light-weight slimbus controller driver responsible for
	  communicating with slave HW directly over the bus using messaging
	  interface, and communicating with master component residing on ADSP
	  for bandwidth and data-channel management.

endif
```
