/*
 * Copyright (c) 2017, 2020, The Linux Foundation. All rights reserved.
 *
 * Permission to use, copy, modify, and/or distribute this software for any
 * purpose with or without fee is hereby granted, provided that the above
 * copyright notice and this permission notice appear in all copies.
 *
 * THE SOFTWARE IS PROVIDED "AS IS" AND THE AUTHOR DISCLAIMS ALL WARRANTIES
 * WITH REGARD TO THIS SOFTWARE INCLUDING ALL IMPLIED WARRANTIES OF
 * MERCHANTABILITY AND FITNESS. IN NO EVENT SHALL THE AUTHOR BE LIABLE FOR
 * ANY SPECIAL, DIRECT, INDIRECT, OR CONSEQUENTIAL DAMAGES OR ANY DAMAGES
 * WHATSOEVER RESULTING FROM LOSS OF USE, DATA OR PROFITS, WHETHER IN AN
 * ACTION OF CONTRACT, NEGLIGENCE OR OTHER TORTIOUS ACTION, ARISING OUT OF
 * OR IN CONNECTION WITH THE USE OR PERFORMANCE OF THIS SOFTWARE.
 */

/ {
	clk_test {
		compatible = "clk-test";
		clocks = <&gcc GPLL0_MAIN>,
			<&gcc GPLL0>,
			<&gcc GPLL2_MAIN>,
			<&gcc GPLL2>,
			<&gcc GPLL4_MAIN>,
			<&gcc GPLL4>,
			<&gcc UBI32_PLL_MAIN>,
			<&gcc UBI32_PLL>,
			<&gcc ADSS_PWM_CLK_SRC>,
			<&gcc APSS_AHB_CLK_SRC>,
			<&gcc APSS_AHB_POSTDIV_CLK_SRC>,
			<&gcc APSS_AXI_CLK_SRC>,
			<&gcc BLSP1_QUP1_I2C_APPS_CLK_SRC>,
			<&gcc BLSP1_QUP1_SPI_APPS_CLK_SRC>,
			<&gcc BLSP1_QUP2_I2C_APPS_CLK_SRC>,
			<&gcc BLSP1_QUP2_SPI_APPS_CLK_SRC>,
			<&gcc BLSP1_QUP3_I2C_APPS_CLK_SRC>,
			<&gcc BLSP1_QUP3_SPI_APPS_CLK_SRC>,
			<&gcc BLSP1_UART1_APPS_CLK_SRC>,
			<&gcc BLSP1_UART2_APPS_CLK_SRC>,
			<&gcc CRYPTO_CLK_SRC>,
			<&gcc GCC_ADSS_PWM_CLK>,
			<&gcc GCC_APSS_AHB_CLK>,
			<&gcc GCC_APSS_AXI_CLK>,
			<&gcc GCC_BLSP1_AHB_CLK>,
			<&gcc GCC_BLSP1_QUP1_I2C_APPS_CLK>,
			<&gcc GCC_BLSP1_QUP1_SPI_APPS_CLK>,
			<&gcc GCC_BLSP1_QUP2_I2C_APPS_CLK>,
			<&gcc GCC_BLSP1_QUP2_SPI_APPS_CLK>,
			<&gcc GCC_BLSP1_QUP3_I2C_APPS_CLK>,
			<&gcc GCC_BLSP1_QUP3_SPI_APPS_CLK>,
			<&gcc GCC_BLSP1_UART1_APPS_CLK>,
			<&gcc GCC_BLSP1_UART2_APPS_CLK>,
			<&gcc GCC_BTSS_LPO_CLK>,
			<&gcc GCC_CMN_BLK_AHB_CLK>,
			<&gcc GCC_CMN_BLK_SYS_CLK>,
			<&gcc GCC_CRYPTO_AHB_CLK>,
			<&gcc GCC_CRYPTO_AXI_CLK>,
			<&gcc GCC_CRYPTO_CLK>,
			<&gcc GCC_DCC_CLK>,
			<&gcc GCC_GEPHY_RX_CLK>,
			<&gcc GCC_GEPHY_TX_CLK>,
			<&gcc GCC_GMAC0_CFG_CLK>,
			<&gcc GCC_GMAC0_PTP_CLK>,
			<&gcc GCC_GMAC0_RX_CLK>,
			<&gcc GCC_GMAC0_SYS_CLK>,
			<&gcc GCC_GMAC0_TX_CLK>,
			<&gcc GCC_GMAC1_CFG_CLK>,
			<&gcc GCC_GMAC1_PTP_CLK>,
			<&gcc GCC_GMAC1_RX_CLK>,
			<&gcc GCC_GMAC1_SYS_CLK>,
			<&gcc GCC_GMAC1_TX_CLK>,
			<&gcc GCC_GP1_CLK>,
			<&gcc GCC_GP2_CLK>,
			<&gcc GCC_GP3_CLK>,
			<&gcc GCC_LPASS_CORE_AXIM_CLK>,
			<&gcc GCC_LPASS_SWAY_CLK>,
			<&gcc GCC_MDIO0_AHB_CLK>,
			<&gcc GCC_MDIO1_AHB_CLK>,
			<&gcc GCC_PCIE0_AHB_CLK>,
			<&gcc GCC_PCIE0_AUX_CLK>,
			<&gcc GCC_PCIE0_AXI_M_CLK>,
			<&gcc GCC_PCIE0_AXI_S_BRIDGE_CLK>,
			<&gcc GCC_PCIE0_AXI_S_CLK>,
			<&gcc GCC_PCIE1_AHB_CLK>,
			<&gcc GCC_PCIE1_AUX_CLK>,
			<&gcc GCC_PCIE1_AXI_M_CLK>,
			<&gcc GCC_PCIE1_AXI_S_BRIDGE_CLK>,
			<&gcc GCC_PCIE1_AXI_S_CLK>,
			<&gcc GCC_PRNG_AHB_CLK>,
			<&gcc GCC_Q6_AXIM_CLK>,
			<&gcc GCC_Q6_AXIM2_CLK>,
			<&gcc GCC_Q6_AXIS_CLK>,
			<&gcc GCC_Q6_AHB_CLK>,
			<&gcc GCC_Q6_AHB_S_CLK>,
			<&gcc GCC_Q6_TSCTR_1TO2_CLK>,
			<&gcc GCC_Q6SS_ATBM_CLK>,
			<&gcc GCC_Q6SS_PCLKDBG_CLK>,
			<&gcc GCC_Q6SS_TRIG_CLK>,
			<&gcc GCC_QDSS_AT_CLK>,
			<&gcc GCC_QDSS_CFG_AHB_CLK>,
			<&gcc GCC_QDSS_DAP_AHB_CLK>,
			<&gcc GCC_QDSS_DAP_CLK>,
			<&gcc GCC_QDSS_ETR_USB_CLK>,
			<&gcc GCC_QDSS_EUD_AT_CLK>,
			<&gcc GCC_QDSS_STM_CLK>,
			<&gcc GCC_QDSS_TRACECLKIN_CLK>,
			<&gcc GCC_QDSS_TSCTR_DIV8_CLK>,
			<&gcc GCC_QPIC_AHB_CLK>,
			<&gcc GCC_QPIC_CLK>,
			<&gcc GCC_QPIC_IO_MACRO_CLK>,
			<&gcc GCC_SDCC1_AHB_CLK>,
			<&gcc GCC_SDCC1_APPS_CLK>,
			<&gcc GCC_SLEEP_CLK_SRC>,
			<&gcc GCC_SNOC_GMAC0_AHB_CLK>,
			<&gcc GCC_SNOC_GMAC0_AXI_CLK>,
			<&gcc GCC_SNOC_GMAC1_AHB_CLK>,
			<&gcc GCC_SNOC_GMAC1_AXI_CLK>,
			<&gcc GCC_SNOC_LPASS_AXIM_CLK>,
			<&gcc GCC_SNOC_LPASS_SWAY_CLK>,
			<&gcc GCC_SNOC_UBI0_AXI_CLK>,
			<&gcc GCC_SYS_NOC_PCIE0_AXI_CLK>,
			<&gcc GCC_SYS_NOC_PCIE1_AXI_CLK>,
			<&gcc GCC_SYS_NOC_QDSS_STM_AXI_CLK>,
			<&gcc GCC_SYS_NOC_USB0_AXI_CLK>,
			<&gcc GCC_SYS_NOC_WCSS_AHB_CLK>,
			<&gcc GCC_UBI0_AXI_CLK>,
			<&gcc GCC_UBI0_CFG_CLK>,
			<&gcc GCC_UBI0_CORE_CLK>,
			<&gcc GCC_UBI0_DBG_CLK>,
			<&gcc GCC_UBI0_NC_AXI_CLK>,
			<&gcc GCC_UBI0_UTCM_CLK>,
			<&gcc GCC_UNIPHY_AHB_CLK>,
			<&gcc GCC_UNIPHY_RX_CLK>,
			<&gcc GCC_UNIPHY_SYS_CLK>,
			<&gcc GCC_UNIPHY_TX_CLK>,
			<&gcc GCC_USB0_AUX_CLK>,
			<&gcc GCC_USB0_EUD_AT_CLK>,
			<&gcc GCC_USB0_LFPS_CLK>,
			<&gcc GCC_USB0_MASTER_CLK>,
			<&gcc GCC_USB0_MOCK_UTMI_CLK>,
			<&gcc GCC_USB0_PHY_CFG_AHB_CLK>,
			<&gcc GCC_USB0_SLEEP_CLK>,
			<&gcc GCC_WCSS_ACMT_CLK>,
			<&gcc GCC_WCSS_AHB_S_CLK>,
			<&gcc GCC_WCSS_AXI_M_CLK>,
			<&gcc GCC_WCSS_AXI_S_CLK>,
			<&gcc GCC_WCSS_DBG_IFC_APB_BDG_CLK>,
			<&gcc GCC_WCSS_DBG_IFC_APB_CLK>,
			<&gcc GCC_WCSS_DBG_IFC_ATB_BDG_CLK>,
			<&gcc GCC_WCSS_DBG_IFC_ATB_CLK>,
			<&gcc GCC_WCSS_DBG_IFC_DAPBUS_BDG_CLK>,
			<&gcc GCC_WCSS_DBG_IFC_DAPBUS_CLK>,
			<&gcc GCC_WCSS_DBG_IFC_NTS_BDG_CLK>,
			<&gcc GCC_WCSS_DBG_IFC_NTS_CLK>,
			<&gcc GCC_WCSS_ECAHB_CLK>,
			<&gcc GCC_XO_CLK>,
			<&gcc GCC_XO_CLK_SRC>,
			<&gcc GMAC0_RX_CLK_SRC>,
			<&gcc GMAC0_TX_CLK_SRC>,
			<&gcc GMAC1_RX_CLK_SRC>,
			<&gcc GMAC1_TX_CLK_SRC>,
			<&gcc GMAC_CLK_SRC>,
			<&gcc GP1_CLK_SRC>,
			<&gcc GP2_CLK_SRC>,
			<&gcc GP3_CLK_SRC>,
			<&gcc LPASS_AXIM_CLK_SRC>,
			<&gcc LPASS_SWAY_CLK_SRC>,
			<&gcc PCIE0_AUX_CLK_SRC>,
			<&gcc PCIE0_AXI_CLK_SRC>,
			<&gcc PCIE1_AUX_CLK_SRC>,
			<&gcc PCIE1_AXI_CLK_SRC>,
			<&gcc PCNOC_BFDCD_CLK_SRC>,
			<&gcc Q6_AXI_CLK_SRC>,
			<&gcc QDSS_AT_CLK_SRC>,
			<&gcc QDSS_STM_CLK_SRC>,
			<&gcc QDSS_TSCTR_CLK_SRC>,
			<&gcc QDSS_TRACECLKIN_CLK_SRC>,
			<&gcc QPIC_IO_MACRO_CLK_SRC>,
			<&gcc SDCC1_APPS_CLK_SRC>,
			<&gcc SYSTEM_NOC_BFDCD_CLK_SRC>,
			<&gcc UBI0_AXI_CLK_SRC>,
			<&gcc UBI0_CORE_CLK_SRC>,
			<&gcc USB0_AUX_CLK_SRC>,
			<&gcc USB0_LFPS_CLK_SRC>,
			<&gcc USB0_MASTER_CLK_SRC>,
			<&gcc USB0_MOCK_UTMI_CLK_SRC>,
			<&gcc WCSS_AHB_CLK_SRC>,
			<&gcc PCIE0_PIPE_CLK_SRC>,
			<&gcc PCIE1_PIPE_CLK_SRC>,
			<&gcc GCC_PCIE0_PIPE_CLK>,
			<&gcc USB0_PIPE_CLK_SRC>,
			<&gcc GCC_PCIE1_PIPE_CLK>,
			<&gcc GCC_USB0_PIPE_CLK>,
			<&gcc GMAC0_RX_DIV_CLK_SRC>,
			<&gcc GMAC0_TX_DIV_CLK_SRC>,
			<&gcc GMAC1_RX_DIV_CLK_SRC>,
			<&gcc GMAC1_TX_DIV_CLK_SRC>;
		clock-names = "gpll0_main",
				"gpll0",
				"gpll2_main",
				"gpll2",
				"gpll4_main",
				"gpll4",
				"ubi32_pll_main",
				"ubi32_pll",
				"apss_ahb_clk_src",
				"apss_ahb_postdiv_clk_src",
				"apss_axi_clk_src",
				"blsp1_qup1_i2c_apps_clk_src",
				"blsp1_qup1_spi_apps_clk_src",
				"blsp1_qup2_i2c_apps_clk_src",
				"blsp1_qup2_spi_apps_clk_src",
				"blsp1_qup3_i2c_apps_clk_src",
				"blsp1_qup3_spi_apps_clk_src",
				"blsp1_uart1_apps_clk_src",
				"blsp1_uart2_apps_clk_src",
				"crypto_clk_src",
				"gcc_apss_ahb_clk",
				"gcc_apss_axi_clk",
				"gcc_blsp1_ahb_clk",
				"gcc_blsp1_qup1_i2c_apps_clk",
				"gcc_blsp1_qup1_spi_apps_clk",
				"gcc_blsp1_qup2_i2c_apps_clk",
				"gcc_blsp1_qup2_spi_apps_clk",
				"gcc_blsp1_qup3_i2c_apps_clk",
				"gcc_blsp1_qup3_spi_apps_clk",
				"gcc_blsp1_uart1_apps_clk",
				"gcc_blsp1_uart2_apps_clk",
				"gcc_btss_lpo_clk",
				"gcc_cmn_blk_ahb_clk",
				"gcc_cmn_blk_sys_clk",
				"gcc_crypto_ahb_clk",
				"gcc_crypto_axi_clk",
				"gcc_crypto_clk",
				"gcc_dcc_clk",
				"gcc_gephy_rx_clk",
				"gcc_gephy_tx_clk",
				"gcc_gmac0_cfg_clk",
				"gcc_gmac0_ptp_clk",
				"gcc_gmac0_rx_clk",
				"gcc_gmac0_sys_clk",
				"gcc_gmac0_tx_clk",
				"gcc_gmac1_cfg_clk",
				"gcc_gmac1_ptp_clk",
				"gcc_gmac1_rx_clk",
				"gcc_gmac1_sys_clk",
				"gcc_gmac1_tx_clk",
				"gcc_gp1_clk",
				"gcc_gp2_clk",
				"gcc_gp3_clk",
				"gcc_lpass_core_axim_clk",
				"gcc_lpass_sway_clk",
				"gcc_mdio0_ahb_clk",
				"gcc_mdio1_ahb_clk",
				"gcc_pcie0_ahb_clk",
				"gcc_pcie0_aux_clk",
				"gcc_pcie0_axi_m_clk",
				"gcc_pcie0_axi_s_bridge_clk",
				"gcc_pcie0_axi_s_clk",
				"gcc_pcie1_ahb_clk",
				"gcc_pcie1_aux_clk",
				"gcc_pcie1_axi_m_clk",
				"gcc_pcie1_axi_s_bridge_clk",
				"gcc_pcie1_axi_s_clk",
				"gcc_prng_ahb_clk",
				"gcc_q6_axim_clk",
				"gcc_q6_axim2_clk",
				"gcc_q6_axis_clk",
				"gcc_q6_ahb_clk",
				"gcc_q6_ahb_s_clk",
				"gcc_q6_tsctr_1to2_clk",
				"gcc_q6ss_atbm_clk",
				"gcc_q6ss_pclkdbg_clk",
				"gcc_q6ss_trig_clk",
				"gcc_qdss_at_clk",
				"gcc_qdss_cfg_ahb_clk",
				"gcc_qdss_dap_ahb_clk",
				"gcc_qdss_dap_clk",
				"gcc_qdss_etr_usb_clk",
				"gcc_qdss_eud_at_clk",
				"gcc_qdss_stm_clk",
				"gcc_qdss_traceclkin_clk",
				"gcc_qdss_tsctr_div8_clk",
				"gcc_qpic_ahb_clk",
				"gcc_qpic_clk",
				"gcc_qpic_io_macro_clk",
				"gcc_sdcc1_ahb_clk",
				"gcc_sdcc1_apps_clk",
				"gcc_sleep_clk_src",
				"gcc_snoc_gmac0_ahb_clk",
				"gcc_snoc_gmac0_axi_clk",
				"gcc_snoc_gmac1_ahb_clk",
				"gcc_snoc_gmac1_axi_clk",
				"gcc_snoc_lpass_axim_clk",
				"gcc_snoc_lpass_sway_clk",
				"gcc_snoc_ubi0_axi_clk",
				"gcc_sys_noc_pcie0_axi_clk",
				"gcc_sys_noc_pcie1_axi_clk",
				"gcc_sys_noc_qdss_stm_axi_clk",
				"gcc_sys_noc_usb0_axi_clk",
				"gcc_sys_noc_wcss_ahb_clk",
				"gcc_ubi0_axi_clk",
				"gcc_ubi0_cfg_clk",
				"gcc_ubi0_core_clk",
				"gcc_ubi0_dbg_clk",
				"gcc_ubi0_nc_axi_clk",
				"gcc_ubi0_utcm_clk",
				"gcc_uniphy_ahb_clk",
				"gcc_uniphy_rx_clk",
				"gcc_uniphy_sys_clk",
				"gcc_uniphy_tx_clk",
				"gcc_usb0_aux_clk",
				"gcc_usb0_eud_at_clk",
				"gcc_usb0_lfps_clk",
				"gcc_usb0_master_clk",
				"gcc_usb0_mock_utmi_clk",
				"gcc_usb0_phy_cfg_ahb_clk",
				"gcc_usb0_sleep_clk",
				"gcc_wcss_acmt_clk",
				"gcc_wcss_ahb_s_clk",
				"gcc_wcss_axi_m_clk",
				"gcc_wcss_axi_s_clk",
				"gcc_wcss_dbg_ifc_apb_bdg_clk",
				"gcc_wcss_dbg_ifc_apb_clk",
				"gcc_wcss_dbg_ifc_atb_bdg_clk",
				"gcc_wcss_dbg_ifc_atb_clk",
				"gcc_wcss_dbg_ifc_dapbus_bdg_clk",
				"gcc_wcss_dbg_ifc_dapbus_clk",
				"gcc_wcss_dbg_ifc_nts_bdg_clk",
				"gcc_wcss_dbg_ifc_nts_clk",
				"gcc_wcss_ecahb_clk",
				"gcc_xo_clk",
				"gcc_xo_clk_src",
				"gmac0_rx_clk_src",
				"gmac0_tx_clk_src",
				"gmac1_rx_clk_src",
				"gmac1_tx_clk_src",
				"gmac_clk_src",
				"gp1_clk_src",
				"gp2_clk_src",
				"gp3_clk_src",
				"lpass_axim_clk_src",
				"lpass_sway_clk_src",
				"pcie0_aux_clk_src",
				"pcie0_axi_clk_src",
				"pcie1_aux_clk_src",
				"pcie1_axi_clk_src",
				"pcnoc_bfdcd_clk_src",
				"q6_axi_clk_src",
				"qdss_at_clk_src",
				"qdss_stm_clk_src",
				"qdss_tsctr_clk_src",
				"qdss_traceclkin_clk_src",
				"qpic_io_macro_clk_src",
				"sdcc1_apps_clk_src",
				"system_noc_bfdcd_clk_src",
				"ubi0_axi_clk_src",
				"ubi0_core_clk_src",
				"usb0_aux_clk_src",
				"usb0_lfps_clk_src",
				"usb0_master_clk_src",
				"usb0_mock_utmi_clk_src",
				"wcss_ahb_clk_src",
				"pcie0_pipe_clk_src",
				"pcie1_pipe_clk_src",
				"gcc_pcie0_pipe_clk",
				"gcc_pcie1_pipe_clk",
				"usb0_pipe_clk_src",
				"gcc_usb0_pipe_clk",
				"gmac0_rx_div_clk_src",
				"gmac0_tx_div_clk_src",
				"gmac1_rx_div_clk_src",
				"gmac1_tx_div_clk_src";
		resets = <&gcc GCC_APC0_VOLTAGE_DROOP_DETECTOR_BCR>,
			<&gcc GCC_BLSP1_BCR>,
			<&gcc GCC_BLSP1_QUP1_BCR>,
			<&gcc GCC_BLSP1_QUP2_BCR>,
			<&gcc GCC_BLSP1_QUP3_BCR>,
			<&gcc GCC_BLSP1_UART1_BCR>,
			<&gcc GCC_BLSP1_UART2_BCR>,
			<&gcc GCC_BOOT_ROM_BCR>,
			<&gcc GCC_BTSS_BCR>,
			<&gcc GCC_CMN_BLK_BCR>,
			<&gcc GCC_CMN_LDO_BCR>,
			<&gcc GCC_CE_BCR>,
			<&gcc GCC_CRYPTO_BCR>,
			<&gcc GCC_DCC_BCR>,
			<&gcc GCC_DCD_BCR>,
			<&gcc GCC_DDRSS_BCR>,
			<&gcc GCC_EDPD_BCR>,
			<&gcc GCC_GEPHY_BCR>,
			<&gcc GCC_GEPHY_MDC_SW_ARES>,
			<&gcc GCC_GEPHY_DSP_HW_ARES>,
			<&gcc GCC_GEPHY_RX_ARES>,
			<&gcc GCC_GEPHY_TX_ARES>,
			<&gcc GCC_GMAC0_BCR>,
			<&gcc GCC_GMAC0_CFG_ARES>,
			<&gcc GCC_GMAC0_SYS_ARES>,
			<&gcc GCC_GMAC1_BCR>,
			<&gcc GCC_GMAC1_CFG_ARES>,
			<&gcc GCC_GMAC1_SYS_ARES>,
			<&gcc GCC_IMEM_BCR>,
			<&gcc GCC_LPASS_BCR>,
			<&gcc GCC_MDIO0_BCR>,
			<&gcc GCC_MDIO1_BCR>,
			<&gcc GCC_MPM_BCR>,
			<&gcc GCC_PCIE0_BCR>,
			<&gcc GCC_PCIE0_LINK_DOWN_BCR>,
			<&gcc GCC_PCIE0_PHY_BCR>,
			<&gcc GCC_PCIE0PHY_PHY_BCR>,
			<&gcc GCC_PCIE0_PIPE_ARES>,
			<&gcc GCC_PCIE0_SLEEP_ARES>,
			<&gcc GCC_PCIE0_CORE_STICKY_ARES>,
			<&gcc GCC_PCIE0_AXI_MASTER_ARES>,
			<&gcc GCC_PCIE0_AXI_SLAVE_ARES>,
			<&gcc GCC_PCIE0_AHB_ARES>,
			<&gcc GCC_PCIE0_AXI_MASTER_STICKY_ARES>,
			<&gcc GCC_PCIE0_AXI_SLAVE_STICKY_ARES>,
			<&gcc GCC_PCIE1_BCR>,
			<&gcc GCC_PCIE1_LINK_DOWN_BCR>,
			<&gcc GCC_PCIE1_PHY_BCR>,
			<&gcc GCC_PCIE1PHY_PHY_BCR>,
			<&gcc GCC_PCIE1_PIPE_ARES>,
			<&gcc GCC_PCIE1_SLEEP_ARES>,
			<&gcc GCC_PCIE1_CORE_STICKY_ARES>,
			<&gcc GCC_PCIE1_AXI_MASTER_ARES>,
			<&gcc GCC_PCIE1_AXI_SLAVE_ARES>,
			<&gcc GCC_PCIE1_AHB_ARES>,
			<&gcc GCC_PCIE1_AXI_MASTER_STICKY_ARES>,
			<&gcc GCC_PCIE1_AXI_SLAVE_STICKY_ARES>,
			<&gcc GCC_PCNOC_BCR>,
			<&gcc GCC_PCNOC_BUS_TIMEOUT0_BCR>,
			<&gcc GCC_PCNOC_BUS_TIMEOUT1_BCR>,
			<&gcc GCC_PCNOC_BUS_TIMEOUT2_BCR>,
			<&gcc GCC_PCNOC_BUS_TIMEOUT3_BCR>,
			<&gcc GCC_PCNOC_BUS_TIMEOUT4_BCR>,
			<&gcc GCC_PCNOC_BUS_TIMEOUT5_BCR>,
			<&gcc GCC_PCNOC_BUS_TIMEOUT6_BCR>,
			<&gcc GCC_PCNOC_BUS_TIMEOUT7_BCR>,
			<&gcc GCC_PCNOC_BUS_TIMEOUT8_BCR>,
			<&gcc GCC_PCNOC_BUS_TIMEOUT9_BCR>,
			<&gcc GCC_PCNOC_BUS_TIMEOUT10_BCR>,
			<&gcc GCC_PCNOC_BUS_TIMEOUT11_BCR>,
			<&gcc GCC_PRNG_BCR>,
			<&gcc GCC_Q6SS_DBG_ARES>,
			<&gcc GCC_Q6_AHB_S_ARES>,
			<&gcc GCC_Q6_AHB_ARES>,
			<&gcc GCC_Q6_AXIM2_ARES>,
			<&gcc GCC_Q6_AXIM_ARES>,
			<&gcc GCC_Q6_AXIS_ARES>,
			<&gcc GCC_QDSS_BCR>,
			<&gcc GCC_QPIC_BCR>,
			<&gcc GCC_QUSB2_0_PHY_BCR>,
			<&gcc GCC_SDCC1_BCR>,
			<&gcc GCC_SEC_CTRL_BCR>,
			<&gcc GCC_SPDM_BCR>,
			<&gcc GCC_SYSTEM_NOC_BCR>,
			<&gcc GCC_TCSR_BCR>,
			<&gcc GCC_TLMM_BCR>,
			<&gcc GCC_UBI0_AXI_ARES>,
			<&gcc GCC_UBI0_AHB_ARES>,
			<&gcc GCC_UBI0_NC_AXI_ARES>,
			<&gcc GCC_UBI0_DBG_ARES>,
			<&gcc GCC_UBI0_UTCM_ARES>,
			<&gcc GCC_UBI0_CORE_ARES>,
			<&gcc GCC_UBI32_BCR>,
			<&gcc GCC_UNIPHY_BCR>,
			<&gcc GCC_UNIPHY_AHB_ARES>,
			<&gcc GCC_UNIPHY_SYS_ARES>,
			<&gcc GCC_UNIPHY_RX_ARES>,
			<&gcc GCC_UNIPHY_TX_ARES>,
			<&gcc GCC_UNIPHY_SOFT_RESET>,
			<&gcc GCC_USB0_BCR>,
			<&gcc GCC_USB0_PHY_BCR>,
			<&gcc GCC_WCSS_BCR>,
			<&gcc GCC_WCSS_DBG_ARES>,
			<&gcc GCC_WCSS_ECAHB_ARES>,
			<&gcc GCC_WCSS_ACMT_ARES>,
			<&gcc GCC_WCSS_DBG_BDG_ARES>,
			<&gcc GCC_WCSS_AHB_S_ARES>,
			<&gcc GCC_WCSS_AXI_M_ARES>,
			<&gcc GCC_WCSS_AXI_S_ARES>,
			<&gcc GCC_WCSS_Q6_BCR>,
			<&gcc GCC_WCSSAON_RESET>;
		reset-names = "gcc_apc0_voltage_droop_detector_bcr",
				"gcc_blsp1_bcr",
				"gcc_blsp1_qup1_bcr",
				"gcc_blsp1_qup2_bcr",
				"gcc_blsp1_qup3_bcr",
				"gcc_blsp1_uart1_bcr",
				"gcc_blsp1_uart2_bcr",
				"gcc_boot_rom_bcr",
				"gcc_btss_bcr",
				"gcc_cmn_blk_bcr",
				"gcc_cmn_ldo_bcr",
				"gcc_ce_bcr",
				"gcc_crypto_bcr",
				"gcc_dcc_bcr",
				"gcc_dcd_bcr",
				"gcc_ddrss_bcr",
				"gcc_edpd_bcr",
				"gcc_gephy_bcr",
				"gcc_gephy_mdc_sw_ares",
				"gcc_gephy_dsp_hw_ares",
				"gcc_gephy_rx_ares",
				"gcc_gephy_tx_ares",
				"gcc_gmac0_bcr",
				"gcc_gmac0_cfg_ares",
				"gcc_gmac0_sys_ares",
				"gcc_gmac1_bcr",
				"gcc_gmac1_cfg_ares",
				"gcc_gmac1_sys_ares",
				"gcc_imem_bcr",
				"gcc_lpass_bcr",
				"gcc_mdio0_bcr",
				"gcc_mdio1_bcr",
				"gcc_mpm_bcr",
				"gcc_pcie0_bcr",
				"gcc_pcie0_link_down_bcr",
				"gcc_pcie0_phy_bcr",
				"gcc_pcie0phy_phy_bcr",
				"gcc_pcie0_pipe_ares",
				"gcc_pcie0_sleep_ares",
				"gcc_pcie0_core_sticky_ares",
				"gcc_pcie0_axi_master_ares",
				"gcc_pcie0_axi_slave_ares",
				"gcc_pcie0_ahb_ares",
				"gcc_pcie0_axi_master_sticky_ares",
				"gcc_pcie0_axi_slave_sticky_ares",
				"gcc_pcie1_bcr",
				"gcc_pcie1_link_down_bcr",
				"gcc_pcie1_phy_bcr",
				"gcc_pcie1phy_phy_bcr",
				"gcc_pcie1_pipe_ares",
				"gcc_pcie1_sleep_ares",
				"gcc_pcie1_core_sticky_ares",
				"gcc_pcie1_axi_master_ares",
				"gcc_pcie1_axi_slave_ares",
				"gcc_pcie1_ahb_ares",
				"gcc_pcie1_axi_master_sticky_ares",
				"gcc_pcie1_axi_slave_sticky_ares",
				"gcc_pcnoc_bcr",
				"gcc_pcnoc_bus_timeout0_bcr",
				"gcc_pcnoc_bus_timeout1_bcr",
				"gcc_pcnoc_bus_timeout2_bcr",
				"gcc_pcnoc_bus_timeout3_bcr",
				"gcc_pcnoc_bus_timeout4_bcr",
				"gcc_pcnoc_bus_timeout5_bcr",
				"gcc_pcnoc_bus_timeout6_bcr",
				"gcc_pcnoc_bus_timeout7_bcr",
				"gcc_pcnoc_bus_timeout8_bcr",
				"gcc_pcnoc_bus_timeout9_bcr",
				"gcc_pcnoc_bus_timeout10_bcr",
				"gcc_pcnoc_bus_timeout11_bcr",
				"gcc_prng_bcr",
				"gcc_q6ss_dbg_ares",
				"gcc_q6_ahb_s_ares",
				"gcc_q6_ahb_ares",
				"gcc_q6_axim2_ares",
				"gcc_q6_axim_ares",
				"gcc_q6_axis_ares",
				"gcc_qdss_bcr",
				"gcc_qpic_bcr",
				"gcc_qusb2_0_phy_bcr",
				"gcc_sdcc1_bcr",
				"gcc_sec_ctrl_bcr",
				"gcc_spdm_bcr",
				"gcc_system_noc_bcr",
				"gcc_tcsr_bcr",
				"gcc_tlmm_bcr",
				"gcc_ubi0_axi_ares",
				"gcc_ubi0_ahb_ares",
				"gcc_ubi0_nc_axi_ares",
				"gcc_ubi0_dbg_ares",
				"gcc_ubi0_utcm_ares",
				"gcc_ubi0_core_ares",
				"gcc_ubi32_bcr",
				"gcc_uniphy_bcr",
				"gcc_uniphy_ahb_ares",
				"gcc_uniphy_sys_ares",
				"gcc_uniphy_rx_ares",
				"gcc_uniphy_tx_ares",
				"gcc_uniphy_soft_reset",
				"gcc_usb0_bcr",
				"gcc_usb0_phy_bcr",
				"gcc_wcss_bcr",
				"gcc_wcss_dbg_ares",
				"gcc_wcss_ecahb_ares",
				"gcc_wcss_acmt_ares",
				"gcc_wcss_dbg_bdg_ares",
				"gcc_wcss_ahb_s_ares",
				"gcc_wcss_axi_m_ares",
				"gcc_wcss_axi_s_ares",
				"gcc_wcss_q6_bcr",
				"gcc_wcssaon_reset";
	};
};
